## Kconfig
```kconfig
# General configuration options

# Copyright (c) 2014-2015 Wind River Systems, Inc.
# SPDX-License-Identifier: Apache-2.0

mainmenu "Minix-rt/$(ARCH) $(KERNEL_VERSION_STRING) Configuration (Project: $(APPLICATION_SOURCE))"

source "scripts/Kconfig.include"

source "kernel/Kconfig"

source "lib/Kconfig"

source "projects/Kconfig"
```

## kernel/Kconfig
```kconfig
# SPDX-License-Identifier: GPL-2.0
#
menu "Minix-rt kernel configuration"

source "kernel/init/Kconfig"

source "kernel/drivers/Kconfig"

source "kernel/lib/Kconfig"

source "kernel/libminix-rt/Kconfig"

source "kernel/lib/Kconfig.debug"

endmenu
```

## kernel/arch/Kconfig
```kconfig
# SPDX-License-Identifier: GPL-2.0
#
# General architecture dependent options
#

source "kernel/arch/$(ARCH)/Kconfig"

menu "General architecture-dependent options"

config HAVE_CMPXCHG_DOUBLE
	bool

config HAVE_STACKPROTECTOR
	bool
	help
	  An arch should select this symbol if:
	  - it has implemented a stack canary (e.g. __stack_chk_guard)

config CC_HAS_STACKPROTECTOR_NONE
	def_bool $(cc-option,-fno-stack-protector)

config STACKPROTECTOR
	bool "Stack Protector buffer overflow detection"
	depends on HAVE_STACKPROTECTOR
	depends on $(cc-option,-fstack-protector)
	default y
	help
	  This option turns on the "stack-protector" GCC feature. This
	  feature puts, at the beginning of functions, a canary value on
	  the stack just before the return address, and validates
	  the value just before actually returning.  Stack based buffer
	  overflows (that need to overwrite this return address) now also
	  overwrite the canary, which gets detected and the attack is then
	  neutralized via a kernel hang.

	  Functions will have the stack-protector canary logic added if they
	  have an 8-byte or larger character array on the stack.

	  This feature requires gcc version 4.2 or above, or a distribution
	  gcc with the feature backported ("-fstack-protector").

	  On an x86 "defconfig" build, this feature adds canary checks to
	  about 3% of all kernel functions, which increases kernel code size
	  by about 0.3%.

config STACKPROTECTOR_STRONG
	bool "Strong Stack Protector"
	depends on STACKPROTECTOR
	depends on $(cc-option,-fstack-protector-strong)
	default y
	help
	  Functions will have the stack-protector canary logic added in any
	  of the following conditions:

	  - local variable's address used as part of the right hand side of an
	    assignment or function argument
	  - local variable is an array (or union containing an array),
	    regardless of array type or length
	  - uses register local variables

	  This feature requires gcc version 4.9 or above, or a distribution
	  gcc with the feature backported ("-fstack-protector-strong").

	  On an x86 "defconfig" build, this feature adds canary checks to
	  about 20% of all kernel functions, which increases the kernel code
	  size by about 2%.

config PGTABLE_LEVELS
	int
	default 2

config ARCH_WANT_LD_ORPHAN_WARN
	bool
	help
	  An arch should select this symbol once all linker sections are explicitly
	  included, size-asserted, or discarded in the linker scripts. This is
	  important because we never want expected sections to be placed heuristically
	  by the linker, since the locations of such sections can change between linker
	  versions.

config CPU_NO_EFFICIENT_FFS
	def_bool n

endmenu
```

## kernel/arch/arm64/Kconfig
```kconfig
# SPDX-License-Identifier: GPL-2.0

config ARM64
	def_bool y
	select ARCH_WANT_FRAME_POINTERS
	select ARCH_WANT_LD_ORPHAN_WARN
	select ARM_GIC
	select ARM_ARCH_TIMER
	select ARM_PSCI_FW
	select BUILDTIME_EXTABLE_SORT
	select FRAME_POINTER
	select HAVE_ALIGNED_STRUCT_PAGE
	select HAVE_CMPXCHG_DOUBLE
	select HAVE_STACKPROTECTOR
	select OF
	select OF_EARLY_FLATTREE
	select OF_RESERVED_MEM

config 64BIT
	def_bool y

config ARM64_PAGE_SHIFT
	int
	default 12

config ARM64_CONT_SHIFT
	int
	default 4

config SMP
	def_bool y

config PGTABLE_LEVELS
	int
	default 4

source "kernel/arch/arm64/Kconfig.platforms"

menu "Kernel Features"

config ARM64_4K_PAGES
	def_bool y
	help
	  This feature enables 4KB pages support.

config ARM64_VA_BITS_48
	def_bool y

config ARM64_VA_BITS
	int
	default 48

config ARM64_PA_BITS
	int
	default 48

config CPU_BIG_ENDIAN
	bool "Build big-endian kernel"
	depends on !LD_IS_LLD || LLD_VERSION >= 130000
	help
	  Say Y if you plan on running a kernel with a big-endian userspace.

config NR_CPUS
	int "Maximum number of CPUs (2-4096)"
	range 2 4096
	# These have to remain sorted largest to smallest
	default "64"

config BROKEN_GAS_INST
	bool "Detected assembler with broken .inst"
	default y

source "kernel/core/Kconfig.hz"

config ARCH_HAS_CACHE_LINE_SIZE
	def_bool y

endmenu
```

## kernel/arch/arm64/Kconfig.platforms
```kconfig
# SPDX-License-Identifier: GPL-2.0

menu "Platform selection"

config ARCH_ORIGIN
	bool "Orign platform"

endmenu
```

## kernel/arch/arm64/configs/defconfig
```kconfig
CONFIG_ARCH_ORIGIN=y
CONFIG_NR_CPUS=8
CONFIG_HZ_100=y
CONFIG_SERIAL_AMBA_PL011=y
CONFIG_CPLUSPLUS=y
CONFIG_LIB_CPLUSPLUS=y
CONFIG_EXCEPTIONS=y
CONFIG_QEMU_VIRT=y
CONFIG_QEMU_APPEND="console=ttyAMA0 rodata=nofull"
```

## kernel/drivers/Kconfig
```kconfig
# SPDX-License-Identifier: GPL-2.0
menu "Device Drivers"

source "kernel/drivers/of/Kconfig"

source "kernel/drivers/irqchip/Kconfig"

source "kernel/drivers/serial/Kconfig"

source "kernel/drivers/firmware/Kconfig"

source "kernel/drivers/clocksource/Kconfig"

endmenu
```

## kernel/drivers/of/Kconfig
```kconfig
config OF_EARLY_FLATTREE
	bool

config OF_RESERVED_MEM
	depends on OF_EARLY_FLATTREE
	bool
	help
	  Helpers to allow for reservation of memory regions

config OF_IRQ
	def_bool y
```

## kernel/drivers/serial/Kconfig
```kconfig
menu "Serial drivers"

config SERIAL_AMBA_PL011
	tristate "ARM AMBA PL011 serial port support"
	help
	  This selects the ARM(R) AMBA(R) PrimeCell PL011 UART.  If you have
	  an Integrator/PP2, Integrator/CP or Versatile platform, say Y or M
	  here.

	  If unsure, say N.

endmenu
```

## kernel/init/Kconfig
```kconfig
# SPDX-License-Identifier: GPL-2.0
#

config CC_IS_GCC
	def_bool $(success,$(CC) --version | head -n 1 | grep -q gcc)

config GCC_VERSION
	int
	default $(shell,$(srctree)/scripts/gcc-version.sh -p $(CC) | sed 's/^0*//') if CC_IS_GCC
	default 0

config CC_IS_CLANG
	def_bool $(success,$(CC) --version | head -n 1 | grep -q clang)

config CLANG_VERSION
	int
	default $(shell,$(srctree)/scripts/clang-version.sh $(CC))

config LD_IS_BFD
	def_bool $(success,test "$(lld-name)" = BFD)

config LD_VERSION
	int
	default $(lld-version) if LD_IS_BFD
	default 0

config LD_IS_LLD
	def_bool $(success,test "$(lld-name)" = LLD)

config LLD_VERSION
	int
	default $(lld-version) if LD_IS_LLD
	default 0

menu "General setup"

config LOCALVERSION
	string "Local version - append to kernel release"
	help
	  Append an extra string to the end of your kernel version.
	  This will show up when you type uname, for example.
	  The string you set here will be appended after the contents of
	  any files with a filename matching localversion* in your
	  object and source tree, in that order.  Your total string can
	  be a maximum of 64 characters.

config LOCALVERSION_AUTO
	bool "Automatically append version information to the version string"
	default y
	help
	  This will try to automatically determine if the current tree is a
	  release tree by looking for git tags that belong to the current
	  top of tree revision.

	  A string of the format -gxxxxxxxx will be added to the localversion
	  if a git-based tree is found.  The string generated by this will be
	  appended after any matching localversion* files, and after the value
	  set in CONFIG_LOCALVERSION.

	  (The actual string used here is the first eight characters produced
	  by running the command:

	    $ git rev-parse --verify HEAD

	  which is done within the script "scripts/setlocalversion".)

config DEFAULT_HOSTNAME
	string "Default hostname"
	default "(none)"
	help
	  This option determines the default system hostname before userspace
	  calls sethostname(2). The kernel traditionally uses "(none)" here,
	  but you may wish to use a different default here to make a minimal
	  system more usable with less configuration.

#
# For architectures that know their GCC __int128 support is sound
#
config ARCH_SUPPORTS_INT128
	bool

choice
	prompt "Compiler optimization level"
	default CC_OPTIMIZE_FOR_PERFORMANCE

config CC_OPTIMIZE_FOR_PERFORMANCE
	bool "Optimize for performance"
	help
	  This is the default optimization level for the kernel, building
	  with the "-O2" compiler flag for best performance and most
	  helpful compile-time warnings.

config CC_OPTIMIZE_FOR_SIZE
	bool "Optimize for size"
	help
	  Enabling this option will pass "-Os" instead of "-O2" to
	  your compiler resulting in a smaller kernel.

	  If unsure, say N.

endchoice

config HAVE_LD_DEAD_CODE_DATA_ELIMINATION
	bool
	help
	  This requires that the arch annotates or otherwise protects
	  its external entry points from being discarded. Linker scripts
	  must also merge .text.*, .data.*, and .bss.* correctly into
	  output sections. Care must be taken not to pull in unrelated
	  sections (e.g., '.text.init'). Typically '.' in section names
	  is used to distinguish them from label names / C identifiers.

config LD_DEAD_CODE_DATA_ELIMINATION
	bool "Dead code and data elimination (EXPERIMENTAL)"
	depends on HAVE_LD_DEAD_CODE_DATA_ELIMINATION
	depends on !(CC_IS_GCC && GCC_VERSION < 40800)
	depends on $(cc-option,-ffunction-sections -fdata-sections)
	depends on $(ld-option,--gc-sections)
	help
	  Enable this if you want to do dead code and data elimination with
	  the linker by compiling with -ffunction-sections -fdata-sections,
	  and linking with --gc-sections.

	  This can reduce on disk and in-memory size of the kernel
	  code and static data, particularly for small configs and
	  on small systems. This has the possibility of introducing
	  silently broken kernel if the required annotations are not
	  present. This option is not well tested yet, so use at your
	  own risk.

config LD_ORPHAN_WARN
	def_bool y
	depends on ARCH_WANT_LD_ORPHAN_WARN
	depends on !LD_IS_LLD || LLD_VERSION >= 110000
	depends on $(ld-option,--orphan-handling=warn)

endmenu		# General setup

source "kernel/arch/Kconfig"
```

## kernel/lib/Kconfig
```kconfig
#
# Library configuration
#

menu "Library routines"

#
# libfdt files, only selected if needed.
#
config LIBFDT
	bool

endmenu
```

## kernel/lib/Kconfig.debug
```kconfig
menu "Kernel hacking"

menu "Compile-time checks and compiler options"

config DEBUG_INFO
	bool "Compile the kernel with debug info"
	depends on DEBUG_KERNEL
	help
          If you say Y here the resulting kernel image will include
	  debugging info resulting in a larger kernel image.
	  This adds debug symbols to the kernel and modules (gcc -g), and
	  is needed if you intend to use kernel crashdump or binary object
	  tools like crash, kgdb, LKCD, gdb, etc on the kernel.
	  Say Y here only if you plan to debug the kernel.

	  If unsure, say N.

config DEBUG_INFO_REDUCED
	bool "Reduce debugging information"
	depends on DEBUG_INFO
	help
	  If you say Y here gcc is instructed to generate less debugging
	  information for structure types. This means that tools that
	  need full debugging information (like kgdb or systemtap) won't
	  be happy. But if you merely need debugging information to
	  resolve line numbers there is no loss. Advantage is that
	  build directory object sizes shrink dramatically over a full
	  DEBUG_INFO build and compile times are reduced too.
	  Only works with newer gcc versions.

config DEBUG_INFO_SPLIT
	bool "Produce split debuginfo in .dwo files"
	depends on DEBUG_INFO
	help
	  Generate debug info into separate .dwo files. This significantly
	  reduces the build directory size for builds with DEBUG_INFO,
	  because it stores the information only once on disk in .dwo
	  files instead of multiple times in object files and executables.
	  In addition the debug information is also compressed.

	  Requires recent gcc (4.7+) and recent gdb/binutils.
	  Any tool that packages or reads debug information would need
	  to know about the .dwo files and include them.
	  Incompatible with older versions of ccache.

config DEBUG_INFO_DWARF4
	bool "Generate dwarf4 debuginfo"
	depends on DEBUG_INFO
	help
	  Generate dwarf4 debug info. This requires recent versions
	  of gcc and gdb. It makes the debug information larger.
	  But it significantly improves the success of resolving
	  variables in gdb on optimized code.

config ENABLE_MUST_CHECK
	bool "Enable __must_check logic"
	default y
	help
	  Enable the __must_check logic in the kernel build.  Disable this to
	  suppress the "warning: ignoring return value of 'foo', declared with
	  attribute warn_unused_result" messages.

config FRAME_WARN
	int "Warn for stack frames larger than (needs gcc 4.4)"
	range 0 8192
	default 1280 if (!64BIT && PARISC)
	default 1024 if (!64BIT && !PARISC)
	default 2048 if 64BIT
	help
	  Tell gcc to warn at build time for stack frames larger than this.
	  Setting this too low will cause a lot of warnings.
	  Setting it to 0 disables the warning.
	  Requires gcc 4.4

config STRIP_ASM_SYMS
	bool "Strip assembler-generated symbols during link"
	default n
	help
	  Strip internal assembler-generated symbols during a link (symbols
	  that look like '.Lxxx') so they don't pollute the output of
	  get_wchan() and suchlike.

config DEBUG_SECTION_MISMATCH
	bool "Enable full Section mismatch analysis"
	help
	  The section mismatch analysis checks if there are illegal
	  references from one section to another section.
	  During linktime or runtime, some sections are dropped;
	  any use of code/data previously in these sections would
	  most likely result in an oops.
	  In the code, functions and variables are annotated with
	  __init,, etc. (see the full list in include/linux/init.h),
	  which results in the code/data being placed in specific sections.
	  The section mismatch analysis is always performed after a full
	  kernel build, and enabling this option causes the following
	  additional steps to occur:
	  - Add the option -fno-inline-functions-called-once to gcc commands.
	    When inlining a function annotated with __init in a non-init
	    function, we would lose the section information and thus
	    the analysis would not catch the illegal reference.
	    This option tells gcc to inline less (but it does result in
	    a larger kernel).

#
# Select this config option from the architecture Kconfig, if it
# is preferred to always offer frame pointers as a config
# option on the architecture (regardless of KERNEL_DEBUG):
#
config ARCH_WANT_FRAME_POINTERS
	bool

config FRAME_POINTER
	bool "Compile the kernel with frame pointers"
	depends on DEBUG_KERNEL && (M68K || SUPERH) || ARCH_WANT_FRAME_POINTERS
	default y if (DEBUG_INFO) || ARCH_WANT_FRAME_POINTERS
	help
	  If you say Y here the resulting kernel image will be slightly
	  larger and slower, but it gives very useful debugging information
	  in case of kernel bugs. (precise oopses/stacktraces/warnings)

endmenu # "Compiler options"

config DEBUG_KERNEL
	bool "Kernel debugging"
	help
	  Say Y here if you are developing drivers or trying to debug and
	  identify kernel problems.

source "kernel/arch/$(ARCH)/Kconfig.debug"

endmenu # Kernel hacking
```

## lib/Kconfig
```kconfig
# SPDX-License-Identifier: GPL-2.0
#
menu "Minix-rt lib configuration"

source "lib/base/Kconfig"

osource "lib/cpio/Kconfig"

source "lib/memalloc/Kconfig"

source "lib/of/Kconfig"

endmenu
```
