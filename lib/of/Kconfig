## lib/of/Kconfig
```kconfig
# SPDX-License-Identifier: GPL-2.0
#
# SPDX-License-Identifier: GPL-2.0

menuconfig OF
	bool "Device Tree and Open Firmware support"
	help
	  This option enables the device tree infrastructure.
	  It is automatically selected by platforms that need it or can
	  be enabled manually for unittests, overlays or
	  compile-coverage.

if OF

endif # OF
```

## projects/Kconfig
```kconfig
# SPDX-License-Identifier: GPL-2.0
#
menu "Sel4m Projects configuration"

# C++ configuration options

# Copyright (c) 2018 B. Leforestier
# SPDX-License-Identifier: Apache-2.0

menuconfig CPLUSPLUS
	bool "C++ support for the application"
	help
	  This option enables the use of applications built with C++.

if CPLUSPLUS

choice
	prompt "C++ Standard"
	default STD_CPP11
	help
	  C++ Standards.

config STD_CPP98
	bool "C++ 98"
	help
	  1998 C++ standard as modified by the 2003 technical corrigendum
	  and some later defect reports.

config STD_CPP11
	bool "C++ 11"
	help
	  2011 C++ standard, previously known as C++0x.

config STD_CPP14
	bool "C++ 14"
	help
	  2014 C++ standard.

config STD_CPP17
	bool "C++ 17"
	help
	  2017 C++ standard, previously known as C++0x.

config STD_CPP2A
	bool "C++ 2a"
	help
	  Next revision of the C++ standard, which is expected to be published in 2020.

endchoice

config LIB_CPLUSPLUS
	bool "Link with STD C++ library"
	depends on !MINIMAL_LIBC
	help
	  Link with STD C++ Library.

if LIB_CPLUSPLUS

config EXCEPTIONS
	bool "Enable C++ exceptions support"
	help
	  This option enables support of C++ exceptions.

config RTTI
	bool "Enable C++ RTTI support"
	help
	  This option enables support of C++ RTTI.

endif # LIB_CPLUSPLUS

endif # CPLUSPLUS

menu "Compiler Options"

choice
	prompt "Optimization level"
	default SPEED_OPTIMIZATIONS
	help
	Note that these flags shall only control the compiler
	optimization level, and that no extra debug code shall be
	conditionally compiled based on them.

config SIZE_OPTIMIZATIONS
	bool "Optimize for size"
	help
	  Compiler optimizations will be set to -Os independently of other
	  options.

config SPEED_OPTIMIZATIONS
	bool "Optimize for speed"
	help
	  Compiler optimizations will be set to -O2 independently of other
	  options.

config DEBUG_OPTIMIZATIONS
	bool "Optimize debugging experience"
	help
	  Compiler optimizations will be set to -Og independently of other
	  options.

config NO_OPTIMIZATIONS
	bool "Optimize nothing"
	help
	  Compiler optimizations will be set to -O0 independently of other
	  options.

endchoice

config DEBUG_APP
	bool "Debugging application"
	default n
	depends on !DEBUG_OPTIMIZATIONS
	help
	  Compiler Debug will be set to -g independently of other
	  options.

endmenu

menuconfig QEMU_VIRT
	bool "Qemu virt Support for the application"
	help
	  This option enables qemu virt.

if QEMU_VIRT

config QEMU_SYSTEM
	string "Qemu system select"
	default "aarch64" if ARM64


config QEMU_CPU
	string "Qemu cpu select"
	default "cortex-a57" if ARM64

config QEMU_MACHINE
	string
	default "virt"

config QEMU_APPEND
	string "Qemu append"
	default ""

config QEMU_INITRD
	string "Qemu initrd"
	default ""

config QEMU_MEMORY
	string "Qemu memory"
	default "4G"

config QEMU_GRAPHIC
	bool "Qemu graphic"
	default n

config QEMU_DEBUG
	bool "Qemu debug"
	default n

endif

menuconfig HAS_PROJECT
	bool "Project $(APPLICATION_SOURCE) Configuration"

if HAS_PROJECT
osource "$(APPLICATION_SOURCE_DIR)/Kconfig"
endif

endmenu
```

## projects/linux-test/configs/linux_defconfig
```kconfig
CONFIG_ARCH_ORIGIN=y
CONFIG_NR_CPUS=8
CONFIG_HZ_1000=y
CONFIG_SERIAL_AMBA_PL011=y
CONFIG_CPLUSPLUS=y
CONFIG_LIB_CPLUSPLUS=y
CONFIG_EXCEPTIONS=y
CONFIG_DEBUG_APP=y
CONFIG_QEMU_VIRT=y
CONFIG_QEMU_APPEND="console=ttyAMA0 rodata=nofull"
CONFIG_HAS_PROJECT=y
```

## servers/Kconfig
```kconfig
# SPDX-License-Identifier: GPL-2.0
#
menu "Minix-rt Servers configuration"

source "servers/pm/Kconfig"
source "servers/fs/Kconfig"

endmenu
```
