## lib/base/Kconfig
```kconfig
# SPDX-License-Identifier: GPL-2.0
#
menu "Base libc configuration"

config ARCH_HAS_FAST_MULTIPLIER
	bool

config GENERIC_FIND_FIRST_BIT
	bool

config BITREVERSE
	bool

config HAVE_ARCH_BITREVERSE
	bool
	default n
	depends on BITREVERSE
	help
	  This option enables the use of hardware bit-reversal instructions on
	  architectures which support such operations.

#
# For architectures that know their GCC __int128 support is sound
#
config ARCH_SUPPORTS_INT128
	bool

source "lib/base/arch/Kconfig"

endmenu
```

## lib/base/arch/arm64/Kconfig
```kconfig
config BASE_ARM64
	def_bool y
	select ARCH_HAS_FAST_MULTIPLIER
	select ARCH_SUPPORTS_INT128 if GCC_VERSION >= 50000 || CC_IS_CLANG
	select CRC32
	select HAVE_ARCH_BITREVERSE
	select HAVE_EFFICIENT_UNALIGNED_ACCESS

config ARCH_PHYS_ADDR_T_64BIT
	def_bool y

config ARCH_DMA_ADDR_T_64BIT
	def_bool y

config GENERIC_HWEIGHT
	def_bool y

config ILLEGAL_POINTER_VALUE
	hex
	default 0xdead000000000000
```

## lib/cpio/Kconfig
```kconfig
#
# SPDX-License-Identifier: GPL-2.0

menuconfig CPIO
	bool "CPIO lib support"

if OF

endif # OF
```

## lib/memalloc/Kconfig
```kconfig
# SPDX-License-Identifier: GPL-2.0
#
menu "Memalloc libc configuration"

config MEMBLOCK_REGIONS_NUM
	int "Memblock regions number"
	default 128

endmenu
```

## lib/memalloc/arch/Kconfig
```kconfig
config HAVE_ALIGNED_STRUCT_PAGE
	bool
	help
	  This makes sure that struct pages are double word aligned and that
	  e.g. the SLUB allocator can perform double word atomic operations
	  on a struct page for better performance. However selecting this
	  might increase the size of a struct page by a word.

source "lib/memalloc/arch/$(ARCH)/Kconfig"
```

## lib/misc/Kconfig
```kconfig
# SPDX-License-Identifier: GPL-2.0
#
menu "Misc libc configuration"

config GENERIC_FIND_FIRST_BIT
	bool

config ARCH_HAS_FAST_MULTIPLIER
	bool

#
# For architectures that know their GCC __int128 support is sound
#
config ARCH_SUPPORTS_INT128
	bool

source "lib/misc/arch/Kconfig"

endmenu
```

## lib/misc/arch/Kconfig
```kconfig
# SPDX-License-Identifier: GPL-2.0
#
# General architecture dependent options
#
config ARCH_USE_BUILTIN_BSWAP
       bool
       help
	 Modern versions of GCC (since 4.4) have builtin functions
	 for handling byte-swapping. Using these, instead of the old
	 inline assembler that the architecture code provides in the
	 __arch_bswapXX() macros, allows the compiler to see what's
	 happening and offers more opportunity for optimisation. In
	 particular, the compiler will be able to combine the byteswap
	 with a nearby load or store and use load-and-swap or
	 store-and-swap instructions if the architecture has them. It
	 should almost *never* result in code which is worse than the
	 hand-coded assembler in <asm/swab.h>.  But just in case it
	 does, the use of the builtins is optional.

	 Any architecture with load-and-swap or store-and-swap
	 instructions should set this. And it shouldn't hurt to set it
	 on architectures that don't have such instructions.

config HAVE_ARCH_COMPILER_H
	bool
	help
	  An architecture can select this if it provides an
	  asm/compiler.h header that should be included after
	  misc/compiler-*.h in order to override macro definitions that those
	  headers generally provide.

config HAVE_EFFICIENT_UNALIGNED_ACCESS
	bool
	help
	  Some architectures are unable to perform unaligned accesses
	  without the use of get_unaligned/put_unaligned. Others are
	  unable to perform such accesses efficiently (e.g. trap on
	  unaligned access and require fixing it up in the exception
	  handler.)

	  This symbol should be selected by an architecture if it can
	  perform unaligned accesses efficiently to allow different
	  code paths to be selected for these cases. Some network
	  drivers, for example, could opt to not fix up alignment
	  problems with received packets if doing so would not help
	  much.

	  See Documentation/unaligned-memory-access.txt for more
	  information on the topic of unaligned memory accesses.

osource "lib/misc/arch/$(ARCH)/Kconfig"
```

## lib/misc/arch/arm64/Kconfig
```kconfig
config MISC_ARM64
	def_bool y
	select ARCH_HAS_FAST_MULTIPLIER
	select ARCH_SUPPORTS_INT128 if GCC_VERSION >= 50000 || CC_IS_CLANG
	select HAVE_EFFICIENT_UNALIGNED_ACCESS

config GENERIC_HWEIGHT
	def_bool y
```
